## layers/meta-balena-raspberrypi/conf/machine/chipsee-ppc-cm4.conf
```bitbake
#@TYPE: Machine
#@NAME: chipsee-ppc-cm4
#@DESCRIPTION: Machine configuration for Chipsee PPC CM4 Board

include conf/machine/include/chipsee-ppc-cm4.inc

MACHINEOVERRIDES = "raspberrypi4-64:${MACHINE}"
MACHINEOVERRIDES := "${@'${MACHINEOVERRIDES}'.replace(':${MACHINE}',':raspberrypi4-64:${MACHINE}')}"

DEFAULTTUNE = "cortexa72"

require conf/machine/include/arm/armv8a/tune-cortexa72.inc
include conf/machine/include/rpi-base.inc

RPI_KERNEL_DEVICETREE_OVERLAYS = " \
    overlays/vc4-fkms-v3d.dtbo \
    overlays/vc4-kms-v3d.dtbo \
    "

RPI_KERNEL_DEVICETREE = "broadcom/bcm2711-rpi-cm4.dtb"

SDIMG_KERNELIMAGE ?= "kernel8.img"
SERIAL_CONSOLES = "115200;ttyAMA0"

UBOOT_MACHINE = "rpi_arm64_config"

VC4DTBO ?= "vc4-kms-v3d"

KERNEL_IMAGETYPE_UBOOT ?= "Image"
KERNEL_IMAGETYPE_DIRECT ?= "Image"
KERNEL_BOOTCMD ?= "booti"

ARMSTUB ?= "armstub8-gic.bin"
RDEPENDS:${PN}:remove = "pi-bluetooth"
RDEPENDS:${PN}:remove = "bluez5"
DISTRO_FEATURES:remove = "bluetooth"
DISTRO_FEATURES_DEFAULT:remove = "bluetooth"
MACHINE_FEATURES:remove = "bluetooth"
COMBINED_FEATURES:remove = "bluetooth"
BINDMOUNTS:remove = "/var/lib/bluetooth"
```

## layers/meta-balena-raspberrypi/conf/machine/include/chipsee-ppc-cm4.inc
```bitbake
IMAGE_INSTALL:append = " cslcd"
IMAGE_INSTALL:append = " gt9xx"
IMAGE_INSTALL:append = " lsm6ds3"

KERNEL_DEVICETREE:append = " overlays/gt9xx.dtbo"
KERNEL_DEVICETREE:append = " overlays/cs-i2c0.dtbo"
KERNEL_DEVICETREE:append = " overlays/pwm-backlight.dtbo"
```
